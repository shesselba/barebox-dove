/*
 * Barebox specific DT overlay for USI Topkick
 *   Sebastian Hesselbarth <sebastian.hesselbarth@gmail.com>
 */

#include "arm/kirkwood-topkick.dts"
#include "kirkwood-usb.dtsi"

/ {
	gpio-leds {
		system {
			barebox,default-trigger = "heartbeat";
		};
	};
};

&usb0 {
	dr_mode = "host";
	status = "okay";
};
