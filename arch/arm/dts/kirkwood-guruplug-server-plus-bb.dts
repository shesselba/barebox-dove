/*
 * Barebox specific DT overlay for Globalscale Guruplug
 *   Sebastian Hesselbarth <sebastian.hesselbarth@gmail.com>
 */

#include "arm/kirkwood-guruplug-server-plus.dts"
#include "kirkwood-usb.dtsi"

/ {
	gpio-leds {
		health-r {
			barebox,default-trigger = "heartbeat";
		};
	};
};

/* USB 2.0 Hub and USB uSD controller */
&usb0 {
	dr_mode = "host";
	status = "okay";
};
