## arch/arm/configs/solidrun_cubox_defconfig
```kconfig
CONFIG_BUILTIN_DTB=y
CONFIG_BUILTIN_DTB_NAME="dove-cubox"
CONFIG_ARCH_MVEBU=y
CONFIG_ARCH_DOVE=y
CONFIG_AEABI=y
CONFIG_DEBUG_LL=y
CONFIG_LONGHELP=y
CONFIG_CMDLINE_EDITING=y
CONFIG_AUTO_COMPLETE=y
CONFIG_CMD_BOOTM_SHOW_TYPE=y
CONFIG_CMD_BOOTM_VERBOSE=y
CONFIG_CMD_BOOTM_INITRD=y
CONFIG_CMD_BOOTM_OFTREE=y
CONFIG_CMD_BOOTM_OFTREE_UIMAGE=y
CONFIG_CMD_CLK=y
CONFIG_CMD_ECHO_E=y
CONFIG_CMD_EDIT=y
CONFIG_CMD_FILETYPE=y
CONFIG_CMD_IOMEM=y
CONFIG_CMD_LN=y
CONFIG_CMD_LOADY=y
CONFIG_CMD_LOADS=y
CONFIG_CMD_MEMINFO=y
CONFIG_CMD_MSLEEP=y
CONFIG_CMD_OFTREE=y
CONFIG_CMD_OF_PROPERTY=y
CONFIG_CMD_OF_NODE=y
CONFIG_CMD_RESET=y
CONFIG_CMD_SLEEP=y
CONFIG_CMD_TFTP=y
CONFIG_CMD_TIME=y
CONFIG_OFDEVICE=y
CONFIG_DRIVER_SERIAL_NS16550=y
```

## drivers/usb/chipidea/Kconfig
```kconfig
config USB_CHIPIDEA
	bool

config USB_CHIPIDEA_HOST
	bool "ChipIdea USB Host support"
	select USB_CHIPIDEA
	select USB_EHCI
	help
	  Enables USB host support for the ChipIdea USB controller.

config USB_CHIPIDEA_DEVICE
	bool "ChipIdea USB Device support"
	select USB_CHIPIDEA
	select USB_HAVE_GADGET_DRIVER
	select USB_GADGET_DRIVER_ARC
	help
	  Enables USB device support for the ChipIdea USB controller.

config USB_CHIPIDEA_GENERIC
	bool "ChipIdea Generic USB 2.0 driver"
	depends on USB_CHIPIDEA
	help
	  Enables a generic USB 2.0 driver for the ChipIdea USB controller
	  found on various SoCs.

config USB_IMX_PHY
	bool

config USB_IMX
	bool "i.MX USB 2.0 driver"
	depends on USB_CHIPIDEA
	depends on ARCH_IMX
	select USB_IMX_PHY if ARCH_IMX6
	help
	  Enables USB 2.0 support for the ChipIdea USB controller found on
	  Freescale i.MX SoCs.

config USB_MVEBU_PHY_40NM
	bool

config USB_MVEBU_PHY_65NM
	bool

config USB_MVEBU_PHY
	bool
	select USB_MVEBU_PHY_40NM if ARCH_ARMADA_370
	select USB_MVEBU_PHY_40NM if ARCH_ARMADA_XP
	select USB_MVEBU_PHY_65NM if ARCH_DOVE
	select USB_MVEBU_PHY_65NM if ARCH_KIRKWOOD

config USB_MVEBU
	bool "Marvell MVEBU USB 2.0 driver"
	depends on USB_CHIPIDEA
	depends on ARCH_MVEBU
	select USB_MVEBU_PHY
	help
	  Enables USB 2.0 support for the ChipIdea USB controller found on
	  Marvell Orion5x, Kirkwood, Dove, Armada 370, and XP SoCs.
```

## drivers/usb/mvebu/Kconfig
```kconfig
config USB_MVEBU_PHY_40NM
	bool

config USB_MVEBU_PHY_65NM
	bool

config USB_MVEBU_PHY
	bool
	depends on USB_MVEBU_HOST || USB_MVEBU_DEVICE
	select USB_MVEBU_PHY_40NM if ARCH_ARMADA_370
	select USB_MVEBU_PHY_40NM if ARCH_ARMADA_XP
	select USB_MVEBU_PHY_65NM if ARCH_DOVE
	select USB_MVEBU_PHY_65NM if ARCH_KIRKWOOD

config USB_MVEBU
	select USB_MVEBU_PHY
	bool

config USB_MVEBU_HOST
	bool "Marvell MVEBU USB host support"
	depends on ARCH_MVEBU
	select USB_MVEBU
	select USB_EHCI
	help
	  Enables USB host support for the ChipIdea USB controller found on
	  Marvell Orion5x, Kirkwood, Dove, Armada 370, and XP SoCs.

config USB_MVEBU_DEVICE
	bool "Marvell MVEBU USB device support"
	depends on ARCH_MVEBU
	select USB_MVEBU
	select USB_GADGET_DRIVER_ARC
	help
	  Enables USB device support for the ChipIdea USB controller found on
	  Marvell Orion5x, Kirkwood, Dove, Armada 370, and XP SoCs.
```
